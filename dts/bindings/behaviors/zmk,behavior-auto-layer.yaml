## dts/bindings/behaviors/zmk,behavior-auto-layer.yaml
```yaml
# Copyright (c) 2024 The ZMK Contributors
# SPDX-License-Identifier: MIT

description: Auto layer behavior

compatible: "zmk,behavior-auto-layer"

include: one_param.yaml

properties:
  continue-list:
    type: array
    required: true
    description: |
      List of key codes which should continue the auto layer behavior.
      If any of the ignore- options are set, this list will be applied
      in addition to them.
  ignore-alphas:
    type: boolean
    description: Continue auto layer behavior for all alpha keys.
  ignore-numbers:
    type: boolean
    description: Continue auto layer behavior for all numbers.
  ignore-modifiers:
    type: boolean
    description: Continue auto layer behavior for all modifiers.
  strict-modifiers:
    type: boolean
    description: |
      Implicitly enables ignore-modifiers, and ensures that modifier+key
      combos bypass ignore-alphas and ignore-numbers and are checked against
      the continue-list instead. This allows modifier+key combos like Ctrl+H
      to be selectively continued while other combos like Ctrl+Z deactivate
      the layer.
```
